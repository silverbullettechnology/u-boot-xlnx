## arch/arm/cpu/armv7/s3ma/Kconfig
```kconfig
if S3MA

choice
	prompt "CLASS Spiral 3 ASIC board select"

config TARGET_CLASS_SP3_DEVEL
	bool "CLASS SP3 Development Board"

config TARGET_CLASS_SP3_BASE
	bool "CLASS SP3 Base Station Board"

config TARGET_CLASS_SP3_MOBILE
	bool "CLASS SP3 Mobile Station Board"
	
endchoice

config SYS_BOARD
	default "sp3dev" if TARGET_CLASS_SP3_DEVEL
	default "sp3base" if TARGET_CLASS_SP3_BASE
	default "sp3mobile" if TARGET_CLASS_SP3_MOBILE


config SYS_VENDOR
	default "exelis"

config SYS_SOC
	default "s3ma"

config SYS_CONFIG_NAME
	default "s3ma_sp3dev" if TARGET_CLASS_SP3_DEVEL
	default "s3ma_sp3dtc" if TARGET_CLASS_SP3_BASE
	default "d3ma_sp3mbl" if TARGET_CLASS_SP3_MOBILE

endif
```

## configs/s3ma_sp3dev_defconfig
```kconfig
CONFIG_ARM=y
CONFIG_S3MA=y
CONFIG_TARGET_S3MA_SP3_BASE=y
CONFIG_OF_CONTROL=n
CONFIG_DEFAULT_DEVICE_TREE="s3ma-sp3dev"
```
